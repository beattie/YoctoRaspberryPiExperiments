## meta-sshserver/conf/layer.conf
```bitbake
# We have a conf and classes directory, add to BBPATH
BBPATH .= ":${LAYERDIR}"

# We have recipes-* directories, add to BBFILES
BBFILES += "${LAYERDIR}/recipes-*/*/*.bb \
            ${LAYERDIR}/recipes-*/*/*.bbappend"

BBFILE_COLLECTIONS += "meta-sshserver"
BBFILE_PATTERN_meta-sshserver = "^${LAYERDIR}/"
BBFILE_PRIORITY_meta-sshserver = "6"

LAYERDEPENDS_meta-sshserver = "core"
LAYERSERIES_COMPAT_meta-sshserver = "warrior zeus"
```

## meta-uartconsole/conf/layer.conf
```bitbake
# We have a conf and classes directory, add to BBPATH
BBPATH .= ":${LAYERDIR}"

# We have recipes-* directories, add to BBFILES
BBFILES += "${LAYERDIR}/recipes-*/*/*.bb \
            ${LAYERDIR}/recipes-*/*/*.bbappend"

BBFILE_COLLECTIONS += "meta-uartconsole"
BBFILE_PATTERN_meta-uartconsole = "^${LAYERDIR}/"
BBFILE_PRIORITY_meta-uartconsole = "6"

LAYERDEPENDS_meta-uartconsole = "core"
LAYERSERIES_COMPAT_meta-uartconsole = "warrior zeus"
```
